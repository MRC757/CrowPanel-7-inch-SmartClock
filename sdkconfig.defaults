## sdkconfig.defaults
```kconfig
# Smart Clock — ESP32-S3 SDK configuration overrides
#
# Resets the GDMA channel at the start of every vertical blanking interval.
# This prevents the Panel_RGB scan pointer from drifting when the CPU or other
# DMA activity (Serial, I2C, WiFi) briefly starves the LCD_CAM engine, which
# manifests as the image shifting left/right on screen.
CONFIG_LCD_RGB_RESTART_IN_VSYNC=y

# Lower the SPIRAM threshold so that allocations > 4 KB (including mbedTLS SSL
# buffers of ~16 KB each) go to PSRAM instead of fragmenting internal SRAM.
# WiFi/LwIP DMA buffers use explicit MALLOC_CAP_INTERNAL|DMA caps — unaffected.
# All JSON docs use static StaticJsonDocument (BSS, not heap) — unaffected.
# LVGL render buffers are allocated with explicit caps — unaffected.
#
# NOTE: CONFIG_MBEDTLS_EXTERNAL_MEM_ALLOC=y would be the ideal fix (forces all
# mbedTLS allocations to PSRAM) but it is a compile-time option baked into the
# pre-compiled Arduino-ESP32 mbedTLS library and cannot be overridden via
# sdkconfig.defaults.  This threshold is the next best thing — it catches the
# large record buffers (2×16 KB) via regular malloc(), though small SSL context
# structs (~440 B) still land in SRAM.
CONFIG_SPIRAM_MALLOC_ALWAYSINTERNAL=4096

# Reduce WiFi static RX buffers from the default 10 to 4.
# Each static RX buffer is 1600 B of internal SRAM.  The default 10 reserves
# 16 KB; 4 buffers reserve 6.4 KB — saving ~9.6 KB of precious internal SRAM.
# 4 buffers is sufficient for a clock that sends one HTTP request at a time
# (no concurrent large data streams).
CONFIG_ESP_WIFI_STATIC_RX_BUFFER_NUM=4
```

## sdkconfig.defaults.esp32s3
```kconfig
# Smart Clock — ESP32-S3 specific SDK overrides (IDF 5.x)
# PlatformIO automatically merges this file for ESP32-S3 targets after sdkconfig.defaults.
#
# These settings require IDF 5.x (Jason2866 platform-espressif32 #Arduino/IDF53).
# They are NOT compatible with the official platformio/espressif32 platform (IDF 4.4.x).

# --- 120 MHz OPI PSRAM ---
# CONFIG_IDF_EXPERIMENTAL_FEATURES unlocks CONFIG_SPIRAM_SPEED_120M in IDF 5.x.
# Without it the build rejects 120M as an invalid speed selection.
# Safe on ESP32-S3R8 (8 MB OPI PSRAM) as used by the CrowPanel Advance 7" V1.3.
CONFIG_IDF_EXPERIMENTAL_FEATURES=y
CONFIG_SPIRAM_SPEED_120M=y

# Keep frequently-called functions and read-only data in PSRAM to free IRAM.
# LCD_CAM GDMA already saturates PSRAM bus; these add negligible extra traffic.
CONFIG_SPIRAM_FETCH_INSTRUCTIONS=y
CONFIG_SPIRAM_RODATA=y

# --- CPU and bus performance ---
# 240 MHz CPU is the rated max for ESP32-S3; matches CrowPanel factory firmware.
CONFIG_ESP_DEFAULT_CPU_FREQ_MHZ_240=y

# 1 kHz FreeRTOS tick improves LVGL touch responsiveness and timer accuracy.
CONFIG_FREERTOS_HZ=1000

# 32-byte D-cache line aligns LCD DMA transfers to cache boundaries,
# reducing the number of writeback operations that compete with GDMA.
CONFIG_ESP32S3_DATA_CACHE_LINE_32B=y

# Optimize for speed rather than code size.
CONFIG_COMPILER_OPTIMIZATION_PERF=y
```
